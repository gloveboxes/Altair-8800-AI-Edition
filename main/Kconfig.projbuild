## main/Kconfig.projbuild
```kconfig
menu "Altair 8800"

choice ALTAIR_BOARD
    prompt "Target board"
    default ALTAIR_BOARD_WAVESHARE_RLCD
    help
        Select the physical ESP32-S3 board. This controls board-level pin
        mappings for the display and SD card interfaces.

    config ALTAIR_BOARD_FREENOVE
        bool "Freenove ESP32-S3 with 2.8\" ILI9341 TFT"

    config ALTAIR_BOARD_WAVESHARE_RLCD
        bool "Waveshare ESP32-S3-RLCD-4.2"
endchoice

choice ALTAIR_DISPLAY_DRIVER
    prompt "Front panel display driver"
    default ALTAIR_DISPLAY_ILI9341 if ALTAIR_BOARD_FREENOVE
    default ALTAIR_DISPLAY_ST7305 if ALTAIR_BOARD_WAVESHARE_RLCD
    help
        Select the physical front-panel display backend for the target board.

    config ALTAIR_DISPLAY_ILI9341
        bool "ILI9341 TFT (320x240)"
        depends on ALTAIR_BOARD_FREENOVE

    config ALTAIR_DISPLAY_ST7305
        bool "ST7305 RLCD (Waveshare ESP32-S3-RLCD-4.2)"
        depends on ALTAIR_BOARD_WAVESHARE_RLCD
endchoice

endmenu
```
